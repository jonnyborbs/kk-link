## main/Kconfig.projbuild
```kconfig
menu "QRV Link"

    config QRV_LINK_BLE_NAME
        string "BLE device name"
        default "QRV Link"
        help
            Name the adapter advertises to BLE-KISS apps (max 29 bytes).
            RadioMail only enables frequency control (QSY) for adapters named
            "B.B. Link"; only use that name for local experiments until it is
            coordinated with Island Magic.

    config QRV_LINK_LOG_APP_WRITES
        bool "Log every write from the app (hex)"
        default n
        help
            Log the first bytes of each write an app makes to the TX
            characteristic. Useful to see what an app sends besides KISS
            data frames.

    config QRV_LINK_LAZY_KISS
        bool "Defer the switch to KISS until the app needs it"
        default n
        help
            Stay in CAT mode when an app subscribes and switch the TNC to KISS
            on the app's first data frame, or after 3 s if it sends nothing.
            A frequency change (SetHardware 0xEA) that arrives first then
            needs no KISS exit. Listen-only apps miss packets during those 3 s.

endmenu
```
